## tRs2Wifi/main/Kconfig.projbuild
```kconfig
menu "Example Configuration"
config ESP_WIFI_SSID
    string "WiFi SSID"
    default ""
    help
        Wi-Fi network name for the station to connect to.

config ESP_WIFI_PASSWORD
    string "WiFi Password"
    default ""
    help
        Wi-Fi password. Leave empty for an open network.
endmenu
```
